## layers/meta-balena-rockpro64/conf/layer.conf
```bitbake
BBPATH .= ":${LAYERDIR}"

BBFILES += "${LAYERDIR}/recipes-*/*/*.bb \
            ${LAYERDIR}/recipes-*/*/*.bbappend"

BBFILE_COLLECTIONS += "balena-rockpro64"
BBFILE_PATTERN_balena-rockpro64 := "^${LAYERDIR}/"
BBFILE_PRIORITY_balena-rockpro64 = "1337"

LAYERSERIES_COMPAT_balena-rockpro64 = "honister"

# we do not use Rockchip's old 2017.09 u-boot
BBMASK += "meta-rockchip/recipes-bsp/u-boot"

# mask BSP patch which fails to apply and which we have no use for
BBMASK += "meta-rockchip/recipes-core/systemd/systemd"
 
```

## layers/meta-balena-rockpro64/conf/machine/rockpro64.conf
```bitbake
#@TYPE: Machine
#@NAME: PINE64 ROCKPro64

SOC_FAMILY = "rk3399"

RK_ISP_VERSION := "1"

require conf/machine/include/soc-family.inc
require conf/machine/include/arm/arch-armv8a.inc

PREFERRED_PROVIDER_virtual/bootloader = "u-boot"

PREFERRED_PROVIDER_virtual/kernel = "linux-rockchip"

SERIAL_CONSOLES = "1500000;ttyS2"
KERNEL_IMAGETYPE = "Image.gz"
KBUILD_DEFCONFIG = "rockchip_linux_defconfig"
KERNEL_DEVICETREE = "rockchip/rk3399-rockpro64.dtb"

UBOOT_MACHINE = "rockpro64-rk3399_defconfig"

#RK_WIFIBT_FIRMWARES = " \
#	rkwifibt-firmware-ap6354-wifi \
#	rkwifibt-firmware-ap6354-bt \
#	brcm-tools \
#"

MACHINE_EXTRA_RRECOMMENDS:append = " \
	linux-firmware-rk-cdndp \
"

FIRMWARE_COMPRESSION = "1"
```
